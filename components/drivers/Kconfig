## components/drivers/Kconfig
```kconfig
menu "Device Drivers"

source "core/Kconfig"
source "ipc/Kconfig"

source "serial/Kconfig"
source "can/Kconfig"
source "cputime/Kconfig"
source "i2c/Kconfig"
source "phy/Kconfig"
source "misc/Kconfig"
source "mtd/Kconfig"
source "pm/Kconfig"
source "rtc/Kconfig"
source "sdio/Kconfig"
source "spi/Kconfig"
source "watchdog/Kconfig"
source "audio/Kconfig"
source "sensor/Kconfig"
source "touch/Kconfig"
source "graphic/Kconfig"
source "hwcrypto/Kconfig"
source "wlan/Kconfig"
source "virtio/Kconfig"
source "ofw/Kconfig"
source "pic/Kconfig"
source "pin/Kconfig"
source "pinctrl/Kconfig"
source "ktime/Kconfig"
source "clk/Kconfig"
source "hwtimer/Kconfig"
source "usb/Kconfig"
source "fdt/Kconfig"

endmenu
```
